## boards/shields/tester_xiao/Kconfig.defconfig
```kconfig
if SHIELD_TESTER_XIAO

# Name must be less than 16 characters long!
config ZMK_KEYBOARD_NAME
    default "Tester XIAO"

endif
```

## boards/shields/testing_board_charlieplexing/Kconfig.defconfig
```kconfig
if SHIELD_TESTING_BOARD_CHARLIEPLEXING

# Name must be less than 16 characters long!
config ZMK_KEYBOARD_NAME
    default "Test board c"

endif
```

## boards/shields/testing_board_charlieplexing/Kconfig.shield
```kconfig
config SHIELD_TESTING_BOARD_CHARLIEPLEXING
    def_bool $(shields_list_contains,testing_board_charlieplexing)
```

## boards/shields/testing_board_matrix/Kconfig.defconfig
```kconfig
if SHIELD_TESTING_BOARD_MATRIX

# Name must be less than 16 characters long!
config ZMK_KEYBOARD_NAME
    default "Test board m"

endif
```

## boards/shields/testing_board_matrix/Kconfig.shield
```kconfig
config SHIELD_TESTING_BOARD_MATRIX
    def_bool $(shields_list_contains,testing_board_matrix)
```

## boards/shields/xiao_tester/Kconfig.defconfig
```kconfig
if SHIELD_XIAO_TESTER

# Name must be less than 16 characters long!
config ZMK_KEYBOARD_NAME
    default "XIAO tester"

endif
```
