## boards/shields/dongle-testing_board_charlieplexing/Kconfig.shield
```kconfig
config SHIELD_DONGLE_TESTING_BOARD_CHARLIEPLEXING
    def_bool $(shields_list_contains,dongle-testing_board_charlieplexing)
```

## boards/shields/dongle-testing_board_matrix/Kconfig.shield
```kconfig
config SHIELD_DONGLE_TESTING_BOARD_MATRIX
    def_bool $(shields_list_contains,dongle-testing_board_matrix)
```
